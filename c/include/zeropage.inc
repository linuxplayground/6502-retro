        .globalzp sp      
        .globalzp sreg    
        .globalzp regsave 
        .globalzp ptr1    
        .globalzp ptr2    
        .globalzp ptr3    
        .globalzp ptr4    
        .globalzp tmp1    
        .globalzp tmp2    
        .globalzp tmp3    
        .globalzp tmp4    
        .globalzp regbank 
        .globalzp tmpstack
        ; xmodem
        .globalzp crc  
        .globalzp crch 
        .globalzp ptr  
        .globalzp ptrh 
        .globalzp blkno
        .globalzp retry
        .globalzp retry2
        .globalzp bflag
        .globalzp XAML 
        .globalzp XAMH 
        .globalzp STL  
        .globalzp STH  
        .globalzp L    
        .globalzp H    
        .globalzp YSAV 
        .globalzp MODE 
        .globalzp MSGL 
        .globalzp MSGH 
        ; keyboard and console
        .globalzp con_r_idx
        .globalzp con_w_idx 
        .globalzp kbd_flags
        .globalzp kbd_scankey
